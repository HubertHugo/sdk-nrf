## CMakeLists.txt
```
#
# Copyright (c) 2021 Nordic Semiconductor ASA
#
# SPDX-License-Identifier: LicenseRef-Nordic-5-Clause
#

cmake_minimum_required(VERSION 3.20.0)

set(multiprotocol_rpmsg_KCONFIG_ROOT "\\\${ZEPHYR_CONNECTEDHOMEIP_MODULE_DIR}/config/nrfconnect/chip-module/Kconfig.multiprotocol_rpmsg.root")
set(hci_ipc_KCONFIG_ROOT "\\\${ZEPHYR_CONNECTEDHOMEIP_MODULE_DIR}/config/nrfconnect/chip-module/Kconfig.hci_ipc.root")

if("${OVERLAY_CONFIG}" STREQUAL "overlay-factory_data.conf")
    set(PM_STATIC_YML_FILE ${CMAKE_CURRENT_SOURCE_DIR}/configuration/${BOARD}/pm_static_factory_data.yml)
endif()

find_package(Zephyr REQUIRED HINTS $ENV{ZEPHYR_BASE})

project(matter-controller)

set(COMMON_ROOT ${ZEPHYR_NRF_MODULE_DIR}/samples/matter/common)
set(NLIO_ROOT ${ZEPHYR_CONNECTEDHOMEIP_MODULE_DIR}/third_party/nlio/repo)
include(${ZEPHYR_CONNECTEDHOMEIP_MODULE_DIR}/config/nrfconnect/app/enable-gnu-std.cmake)
include(${ZEPHYR_CONNECTEDHOMEIP_MODULE_DIR}/src/app/chip_data_model.cmake)

# NORDIC SDK APP START
target_include_directories(app PRIVATE
    src
    ${COMMON_ROOT}/src
    ${NLIO_ROOT}/include
    ${ZEPHYR_CONNECTEDHOMEIP_MODULE_DIR}/zzz_generated/app-common
)

target_sources(app PRIVATE
    src/app_task.cpp
    src/main.cpp
    src/battery.cpp
    src/buzzer.cpp
    src/zap-generated/IMClusterCommandHandler.cpp
    src/zap-generated/callback-stub.cpp
    ${COMMON_ROOT}/src/board/led_widget.cpp
    ${COMMON_ROOT}/src/dfu/smp/dfu_over_smp.cpp
    ${COMMON_ROOT}/src/app/task_executor.cpp
    ${COMMON_ROOT}/src/board/board.cpp
    ${COMMON_ROOT}/src/app/matter_init.cpp
    ${COMMON_ROOT}/src/app/matter_event_handler.cpp
)

if(CONFIG_CHIP_OTA_REQUESTOR OR CONFIG_MCUMGR_TRANSPORT_BT)
    target_sources(app PRIVATE ${COMMON_ROOT}/src/dfu/ota/ota_util.cpp)
endif()

if(CONFIG_NCS_SAMPLE_MATTER_OPERATIONAL_KEYS_MIGRATION_TO_ITS)
    target_sources(app PRIVATE ${COMMON_ROOT}/src/migration/migration_manager.cpp)
endif()

chip_configure_data_model(app
    INCLUDE_SERVER
    BYPASS_IDL
    GEN_DIR src/zap-generated
    ZAP_FILE ${CMAKE_CURRENT_SOURCE_DIR}/src/window_covering_controller.zap
)
# NORDIC SDK APP END
```

## Kconfig
```
#
# Copyright (c) 2021 Nordic Semiconductor
#
# SPDX-License-Identifier: LicenseRef-Nordic-5-Clause
#

mainmenu "Matter controller application"

config AVERAGE_CURRENT_CONSUMPTION
	int "Average device current consumption in microamperes"
	default 0
	help
	  The predicted average current consumption of the Matter controller
	  device, used to estimate the remaining battery time.

# Application configuration used for Thread networking
if NET_L2_OPENTHREAD

choice OPENTHREAD_NORDIC_LIBRARY_CONFIGURATION
	default OPENTHREAD_NORDIC_LIBRARY_MTD
endchoice

choice OPENTHREAD_DEVICE_TYPE
	default OPENTHREAD_MTD
endchoice

config IEEE802154_NRF5_RX_STACK_SIZE
	default 8192

config CHIP_ENABLE_ICD_SUPPORT
	default y

# # Reduce Thread TX output power to 0 dBm for SED device
# config OPENTHREAD_DEFAULT_TX_POWER
# 	int
# 	default 0

endif # NET_L2_OPENTHREAD

source "${ZEPHYR_CONNECTEDHOMEIP_MODULE_DIR}/config/nrfconnect/chip-module/Kconfig.features"
source "${ZEPHYR_CONNECTEDHOMEIP_MODULE_DIR}/config/nrfconnect/chip-module/Kconfig.defaults"
source "${ZEPHYR_BASE}/../nrf/samples/matter/common/src/Kconfig"
source "Kconfig.zephyr"
```

## sample.yaml
```
sample:
  name: Matter Window Covering Controller
  description: Matter Window Covering Controller application
tests:
  # This configuration is used for performing DFU over BLE between different NCS
  # applications on Thingy53.
  applications.matter_window_covering_controller.debug.no_fd:
    build_only: true
    platform_allow: thingy53_nrf5340_cpuapp
    platform_exclude: thingy53_nrf5340_cpuapp_ns
    integration_platforms:
      - thingy53_nrf5340_cpuapp
  applications.matter_window_covering_controller.debug:
    build_only: true
    extra_args: OVERLAY_CONFIG=overlay-factory_data.conf
    platform_allow: thingy53_nrf5340_cpuapp
    platform_exclude: thingy53_nrf5340_cpuapp_ns
    integration_platforms:
      - thingy53_nrf5340_cpuapp
  applications.matter_window_covering_controller.release:
    build_only: true
    extra_args: OVERLAY_CONFIG=overlay-factory_data.conf CONF_FILE=prj_release.conf
    platform_allow: thingy53_nrf5340_cpuapp
    platform_exclude: thingy53_nrf5340_cpuapp_ns
    integration_platforms:
      - thingy53_nrf5340_cpuapp
  applications.matter_window_covering_controller.nrf7002eb:
    build_only: true
    extra_args: SHIELD=nrf7002eb CONF_FILE=prj_release.conf
    platform_allow: thingy53_nrf5340_cpuapp
    platform_exclude: thingy53_nrf5340_cpuapp_ns
    integration_platforms:
      - thingy53_nrf5340_cpuapp
```

## prj.conf
```kconfig
#
# Copyright (c) 2021 Nordic Semiconductor ASA
#
# SPDX-License-Identifier: LicenseRef-Nordic-5-Clause
#

# This sample uses Kconfig.defaults to set options common for all
# samples. This file should contain only options specific for this sample
# or overrides of default values.

# Enable CHIP
CONFIG_CHIP=y
CONFIG_CHIP_ENABLE_PAIRING_AUTOSTART=y
CONFIG_CHIP_PROJECT_CONFIG="src/chip_project_config.h"
# 32781 == 0x800D (matter example of Temperature measurement device as NCS Weather Station)
CONFIG_CHIP_DEVICE_PRODUCT_ID=32781
CONFIG_STD_CPP17=y

# Enable Bluetooth Low Energy
CONFIG_BT_DEVICE_NAME="MatterControl"

# Add support for LEDs, buttons and buzzer
CONFIG_DK_LIBRARY=y
CONFIG_PWM=y

# Configure Thingy:53 sensors
CONFIG_I2C=y
CONFIG_SENSOR=y
CONFIG_BME680=y
CONFIG_ADC=y

# Suspend devices when the CPU goes into sleep
CONFIG_PM_DEVICE=y

# Other settings
CONFIG_IEEE802154_NRF5_RX_STACK_SIZE=8192
CONFIG_THREAD_NAME=y
CONFIG_MPU_STACK_GUARD=y
CONFIG_CHIP_LIB_SHELL=y

# Average Thingy:53 current consumption
CONFIG_AVERAGE_CURRENT_CONSUMPTION=10000

# Enable DFU over Bluetooth LE SMP
CONFIG_CHIP_DFU_OVER_BT_SMP=y

# Increase system workqueue size, as SMP is processed within it
CONFIG_SYSTEM_WORKQUEUE_STACK_SIZE=4096

# 0x0302 (Temp. sensor)
CONFIG_CHIP_DEVICE_TYPE=770
CONFIG_BT_RX_STACK_SIZE=1500

# Configure UART logging and shell
CONFIG_LOG=y
CONFIG_LOG_MODE_DEFERRED=y
CONFIG_LOG_PROCESS_THREAD_STACK_SIZE=1024
CONFIG_LOG_BUFFER_SIZE=8192
CONFIG_LOG_FUNC_NAME_PREFIX_DBG=n
CONFIG_MATTER_LOG_LEVEL_DBG=y
CONFIG_SHELL=y
CONFIG_SHELL_LOG_BACKEND=y

# Configure USB CDC ACM
CONFIG_USB_DEVICE_INITIALIZE_AT_BOOT=n
CONFIG_USB_DEVICE_PRODUCT="MatterController"
CONFIG_USB_DEVICE_PID=0x530D
CONFIG_UART_LINE_CTRL=y
CONFIG_SHELL_BACKEND_SERIAL_INIT_PRIORITY=51

# Use minimal C library instead of the Picolib
CONFIG_MINIMAL_LIBC=y
```

## overlay-factory_data.conf
```kconfig
#
# Copyright (c) 2022 Nordic Semiconductor ASA
#
# SPDX-License-Identifier: LicenseRef-Nordic-5-Clause
#

# Use this overlay to re-generate new PAI and DAC certificates.
# Be sure that chip-cert executable is added to your system PATH.

# Enable building the new factory data
CONFIG_CHIP_FACTORY_DATA=y
CONFIG_CHIP_FACTORY_DATA_BUILD=y
CONFIG_CHIP_FACTORY_DATA_USE_DEFAULT_CERTS=y
CONFIG_CHIP_FACTORY_DATA_MERGE_WITH_FIRMWARE=y
CONFIG_CHIP_DEVICE_GENERATE_ROTATING_DEVICE_UID=n
CONFIG_CHIP_FACTORY_DATA_GENERATE_ONBOARDING_CODES=y

# Set up the Factory Data
CONFIG_CHIP_DEVICE_SERIAL_NUMBER="3"
CONFIG_CHIP_DEVICE_VENDOR_ID=65521
CONFIG_CHIP_DEVICE_VENDOR_NAME="Nordic Semiconductor ASA"
CONFIG_CHIP_DEVICE_PRODUCT_ID=32781
CONFIG_CHIP_DEVICE_PRODUCT_NAME="WindowController"
CONFIG_CHIP_DEVICE_MANUFACTURING_DATE="2022-07-12"
CONFIG_CHIP_DEVICE_HARDWARE_VERSION=1
CONFIG_CHIP_DEVICE_HARDWARE_VERSION_STRING="SVE"
CONFIG_CHIP_DEVICE_DISCRIMINATOR=0x635
CONFIG_CHIP_DEVICE_SPAKE2_PASSCODE=65286841
CONFIG_CHIP_DEVICE_SPAKE2_IT=1000
CONFIG_CHIP_DEVICE_SPAKE2_TEST_VERIFIER="3kX890KClffU+BvLXQm68RDvXWlyuPofi8DEFkv74mQEnC+g02oLJTkItSDLBUvuYX87D1C7SnHZ7PuWvDziO57cHjPgUlkEhlRj+bvWKmE/FEwKuffl+VB7Dlx9HurJwQ=="
CONFIG_CHIP_DEVICE_ROTATING_DEVICE_UID="1566d6032a898e53f7d58133a19ac9d2"
CONFIG_CHIP_DEVICE_ENABLE_KEY="449eb9544ee3eef8d9fb7accb514fada"
```

## src/app_task.cpp
```c
/*
 * Copyright (c) 2021 Nordic Semiconductor ASA
 *
 * SPDX-License-Identifier: LicenseRef-Nordic-5-Clause
 */

#include "app_task.h"

#include "battery.h"
#include "buzzer.h"

#include "app/matter_init.h"
#include "app/task_executor.h"
#include "board/board.h"
#include "board/led_widget.h"

#ifdef CONFIG_CHIP_OTA_REQUESTOR
#include "dfu/ota/ota_util.h"
#endif

#ifdef CONFIG_MCUMGR_TRANSPORT_BT
#include "dfu/smp/dfu_over_smp.h"
#endif


#include <app-common/zap-generated/attributes/Accessors.h>
#include <app-common/zap-generated/cluster-objects.h>
#include <app/server/OnboardingCodesUtil.h>
#include <app/server/Server.h>
#include <app/util/binding-table.h>
#include <controller/InvokeInteraction.h>

#include <platform/CHIPDeviceLayer.h>
#include <zephyr/drivers/sensor.h>
#include <zephyr/logging/log.h>

LOG_MODULE_DECLARE(app, CONFIG_CHIP_APP_LOG_LEVEL);

using namespace ::chip;
using namespace ::chip::DeviceLayer;
using namespace ::chip::app;

#define APPLICATION_BUTTON_MASK DK_BTN2_MSK

namespace
{
enum class FunctionTimerMode { kDisabled, kFactoryResetTrigger, kFactoryResetComplete };
enum class LedState { kAlive, kAdvertisingBle, kConnectedBle, kProvisioned };

#if CONFIG_AVERAGE_CURRENT_CONSUMPTION <= 0
#error Invalid CONFIG_AVERAGE_CURRENT_CONSUMPTION value set
#endif

constexpr size_t kMeasurementsIntervalMs = 3000;
constexpr uint8_t kWindowCoveringControllerEndpointId = 1;

constexpr uint8_t kPowerSourceEndpointId = 0;
constexpr int16_t kMinimalOperatingVoltageMv = 3200;
constexpr int16_t kMaximalOperatingVoltageMv = 4050;
constexpr int16_t kWarningThresholdVoltageMv = 3450;
constexpr int16_t kCriticalThresholdVoltageMv = 3250;
constexpr uint8_t kMinBatteryPercentage = 0;
/* Value is expressed in half percent units ranging from 0 to 200. */
constexpr uint8_t kMaxBatteryPercentage = 200;
/* Battery capacity in uAh */
constexpr uint32_t kBatteryCapacityUaH = 1350000;
/* Average device current consumption in uA */
constexpr uint32_t kDeviceAverageCurrentConsumptionUa = CONFIG_AVERAGE_CURRENT_CONSUMPTION;
/* Fully charged battery operation time in seconds */
constexpr uint32_t kFullBatteryOperationTime = kBatteryCapacityUaH / kDeviceAverageCurrentConsumptionUa * 3600;
/* It is recommended to toggle the signalled state with 0.5 s interval. */
constexpr size_t kIdentifyTimerIntervalMs = 500;

k_timer sMeasurementsTimer;
k_timer sIdentifyTimer;

//const device *sBme688SensorDev = DEVICE_DT_GET_ONE(bosch_bme680);

Identify sIdentifyWindowCoveringController = { chip::EndpointId{ kWindowCoveringControllerEndpointId }, AppTask::OnIdentifyStart,
				  AppTask::OnIdentifyStop, Clusters::Identify::IdentifyTypeEnum::kAudibleBeep };

} /* namespace */

void AppTask::OnIdentifyStart(Identify *)
{
	Nrf::PostTask(
		[] { Nrf::GetBoard().GetLED(Nrf::DeviceLeds::LED2).Blink(Nrf::LedConsts::kIdentifyBlinkRate_ms); });
	k_timer_start(&sIdentifyTimer, K_MSEC(kIdentifyTimerIntervalMs), K_MSEC(kIdentifyTimerIntervalMs));
}

void AppTask::OnIdentifyStop(Identify *)
{
	k_timer_stop(&sIdentifyTimer);
	BuzzerSetState(false);
}

void AppTask::IdentifyTimerHandler()
{
	BuzzerToggleState();
}

// COPIED FROM SWITCH
void AppTask::InitiateActionSwitch(Action action)
{
	Nrf::Matter::BindingHandler::BindingData *data =
		Platform::New<Nrf::Matter::BindingHandler::BindingData>();
	if (data) {
		data->EndpointId = kWindowCoveringControllerEndpointId;
		data->ClusterId = Clusters::WindowCovering::Id;
		data->InvokeCommandFunc = SwitchChangedHandler;
		switch (action) {
		case Action::PressButton:
			data->CommandId = Clusters::WindowCovering::Commands::UpOrOpen::Id;
			break;
		case Action::Rotate:
			data->CommandId = Clusters::WindowCovering::Commands::DownOrClose::Id;
			break;
		case Action::Idle:
			data->CommandId = Clusters::WindowCovering::Commands::DownOrClose::Id;
			break;
		case Action::Tap:
			data->CommandId = Clusters::WindowCovering::Commands::DownOrClose::Id;
			break;
		case Action::UpDown:
			data->CommandId = Clusters::WindowCovering::Commands::DownOrClose::Id;
			break;
		default:
			Platform::Delete(data);
			return;
		}
		data->IsGroup = Nrf::Matter::BindingHandler::IsGroupBound();
		Nrf::Matter::BindingHandler::RunBoundClusterAction(data);
	}
}

// COPIED FROM SWITCH
void AppTask::SwitchChangedHandler(const EmberBindingTableEntry &binding, OperationalDeviceProxy *deviceProxy,
				       Nrf::Matter::BindingHandler::BindingData &bindingData)
{
	//if (binding.type == EMBER_MULTICAST_BINDING && bindingData.IsGroup) {
	//	switch (bindingData.ClusterId) {
	//	case Clusters::OnOff::Id:
	//		OnOffProcessCommand(bindingData.CommandId, binding, nullptr, bindingData);
	//		break;
	//	case Clusters::LevelControl::Id:
	//		LevelControlProcessCommand(bindingData.CommandId, binding, nullptr, bindingData);
	//		break;
	//	default:
	//		ChipLogError(NotSpecified, "Invalid binding group command data");
	//		break;
	//	}
	//} else if (binding.type == EMBER_UNICAST_BINDING && !bindingData.IsGroup) {
	//	switch (bindingData.ClusterId) {
	//	case Clusters::OnOff::Id:
	//		OnOffProcessCommand(bindingData.CommandId, binding, deviceProxy, bindingData);
	//		break;
	//	case Clusters::LevelControl::Id:
	//		LevelControlProcessCommand(bindingData.CommandId, binding, deviceProxy, bindingData);
	//		break;
	//	default:
	//		ChipLogError(NotSpecified, "Invalid binding unicast command data");
	//		break;
	//	}
	//}
}

void AppTask::WindowCoveringActionEventHandler(){
    //EXAMPLE OF LOCK FUNCTIONALITY
        //if (BoltLockMgr().IsLocked()) {
	    //	BoltLockMgr().Unlock(BoltLockManager::OperationSource::kButton);
	    //} else {
	    //	BoltLockMgr().Lock(BoltLockManager::OperationSource::kButton);
	    //}
	//Instance().UpdateClustersState();
}

// COPIED FROM SWITCH
void AppTask::ButtonEventHandler(Nrf::ButtonState state, Nrf::ButtonMask hasChanged)
{
	if ((APPLICATION_BUTTON_MASK & state & hasChanged)) {
		Nrf::PostTask([] { WindowCoveringActionEventHandler(); });
	}
}

void AppTask::UpdatePowerSourceClusterState()
{
	EmberAfStatus status;
	int32_t voltage = BatteryMeasurementReadVoltageMv();
	/* Value is expressed in half percent units ranging from 0 to 200. */
	uint8_t batteryPercentage;
	uint32_t batteryTimeRemaining;
	Clusters::PowerSource::PowerSourceStatusEnum batteryStatus;
	Clusters::PowerSource::BatChargeLevelEnum batteryChargeLevel;
	bool batteryPresent;
	Clusters::PowerSource::BatChargeStateEnum batteryCharged;

	if (voltage < 0) {
		voltage = 0;
		batteryPercentage = 0;
		batteryStatus = Clusters::PowerSource::PowerSourceStatusEnum::kUnavailable;
		batteryPresent = false;

		LOG_ERR("Battery level measurement failed %d", voltage);
	} else {
		batteryStatus = Clusters::PowerSource::PowerSourceStatusEnum::kActive;
		batteryPresent = true;
	}

	if (voltage <= kMinimalOperatingVoltageMv) {
		batteryPercentage = kMinBatteryPercentage;
	} else if (voltage >= kMaximalOperatingVoltageMv) {
		batteryPercentage = kMaxBatteryPercentage;
	} else {
		batteryPercentage = kMaxBatteryPercentage * (voltage - kMinimalOperatingVoltageMv) /
				    (kMaximalOperatingVoltageMv - kMinimalOperatingVoltageMv);
	}

	batteryTimeRemaining = kFullBatteryOperationTime * batteryPercentage / kMaxBatteryPercentage;

	if (voltage < kCriticalThresholdVoltageMv) {
		batteryChargeLevel = Clusters::PowerSource::BatChargeLevelEnum::kCritical;
	} else if (voltage < kWarningThresholdVoltageMv) {
		batteryChargeLevel = Clusters::PowerSource::BatChargeLevelEnum::kWarning;
	} else {
		batteryChargeLevel = Clusters::PowerSource::BatChargeLevelEnum::kOk;
	}

	if (BatteryCharged()) {
		batteryCharged = Clusters::PowerSource::BatChargeStateEnum::kIsCharging;
	} else {
		batteryCharged = Clusters::PowerSource::BatChargeStateEnum::kIsNotCharging;
	}

	status = Clusters::PowerSource::Attributes::BatVoltage::Set(kPowerSourceEndpointId, voltage);
	if (status != EMBER_ZCL_STATUS_SUCCESS) {
		LOG_ERR("Updating battery voltage failed %x", status);
	}

	status = Clusters::PowerSource::Attributes::BatPercentRemaining::Set(kPowerSourceEndpointId, batteryPercentage);
	if (status != EMBER_ZCL_STATUS_SUCCESS) {
		LOG_ERR("Updating battery percentage failed %x", status);
	}

	status = Clusters::PowerSource::Attributes::BatTimeRemaining::Set(kPowerSourceEndpointId, batteryTimeRemaining);
	if (status != EMBER_ZCL_STATUS_SUCCESS) {
		LOG_ERR("Updating battery time remaining failed %x", status);
	}

	status = Clusters::PowerSource::Attributes::BatChargeLevel::Set(kPowerSourceEndpointId, batteryChargeLevel);
	if (status != EMBER_ZCL_STATUS_SUCCESS) {
		LOG_ERR("Updating battery charge level failed %x", status);
	}

	status = Clusters::PowerSource::Attributes::Status::Set(kPowerSourceEndpointId, batteryStatus);
	if (status != EMBER_ZCL_STATUS_SUCCESS) {
		LOG_ERR("Updating battery status failed %x", status);
	}

	status = Clusters::PowerSource::Attributes::BatPresent::Set(kPowerSourceEndpointId, batteryPresent);
	if (status != EMBER_ZCL_STATUS_SUCCESS) {
		LOG_ERR("Updating battery present failed %x", status);
	}

	status = Clusters::PowerSource::Attributes::BatChargeState::Set(kPowerSourceEndpointId, batteryCharged);
	if (status != EMBER_ZCL_STATUS_SUCCESS) {
		LOG_ERR("Updating battery charge failed %x", status);
	}
}

void AppTask::UpdateLedState()
{
	if (!Instance().mGreenLED || !Instance().mBlueLED || !Instance().mRedLED) {
		return;
	}

	Instance().mGreenLED->Set(false);
	Instance().mBlueLED->Set(false);
	Instance().mRedLED->Set(false);

	switch (Nrf::GetBoard().GetDeviceState()) {
	case Nrf::DeviceState::DeviceAdvertisingBLE:
		Instance().mBlueLED->Blink(Nrf::LedConsts::StatusLed::Disconnected::kOn_ms,
					   Nrf::LedConsts::StatusLed::Disconnected::kOff_ms);
		break;
	case Nrf::DeviceState::DeviceDisconnected:
		Instance().mGreenLED->Blink(Nrf::LedConsts::StatusLed::Disconnected::kOn_ms,
					    Nrf::LedConsts::StatusLed::Disconnected::kOff_ms);
		break;
	case Nrf::DeviceState::DeviceConnectedBLE:
		Instance().mBlueLED->Blink(Nrf::LedConsts::StatusLed::BleConnected::kOn_ms,
					   Nrf::LedConsts::StatusLed::BleConnected::kOff_ms);
		break;
	case Nrf::DeviceState::DeviceProvisioned:
		Instance().mRedLED->Blink(Nrf::LedConsts::StatusLed::Disconnected::kOn_ms,
					  Nrf::LedConsts::StatusLed::Disconnected::kOff_ms);
		Instance().mBlueLED->Blink(Nrf::LedConsts::StatusLed::Disconnected::kOn_ms,
					   Nrf::LedConsts::StatusLed::Disconnected::kOff_ms);
		break;
	default:
		break;
	}
}

CHIP_ERROR AppTask::Init()
{

	/* Initialize Matter stack */
	ReturnErrorOnFailure(Nrf::Matter::PrepareServer());

	/* Set references for RGB LED */
	mRedLED = &Nrf::GetBoard().GetLED(Nrf::DeviceLeds::LED1);
	mGreenLED = &Nrf::GetBoard().GetLED(Nrf::DeviceLeds::LED2);
	mBlueLED = &Nrf::GetBoard().GetLED(Nrf::DeviceLeds::LED3);

	if (!Nrf::GetBoard().Init(ButtonEventHandler, UpdateLedState)) {
		LOG_ERR("User interface initialization failed.");
		return CHIP_ERROR_INCORRECT_STATE;
	}

	/* Register Matter event handler that controls the connectivity status LED based on the captured Matter network
	 * state. */
	ReturnErrorOnFailure(Nrf::Matter::RegisterEventHandler(Nrf::Board::DefaultMatterEventHandler, 0));

	//if (!device_is_ready(sBme688SensorDev)) {
	//	LOG_ERR("BME688 sensor device not ready");
	//	return chip::System::MapErrorZephyr(-ENODEV);
	//}


	int ret = BatteryMeasurementInit();
	if (ret) {
		LOG_ERR("Battery measurement init failed");
		return chip::System::MapErrorZephyr(ret);
	}

	ret = BatteryMeasurementEnable();
	if (ret) {
		LOG_ERR("Enabling battery measurement failed");
		return chip::System::MapErrorZephyr(ret);
	}

	ret = BatteryChargeControlInit();
	if (ret) {
		LOG_ERR("Battery charge control init failed");
		return chip::System::MapErrorZephyr(ret);
	}

	ret = BuzzerInit();
	if (ret) {
		LOG_ERR("Buzzer init failed");
		return chip::System::MapErrorZephyr(ret);
	}

	/* Initialize timers */
	k_timer_init(
		&sIdentifyTimer, [](k_timer *) { Nrf::PostTask([] { IdentifyTimerHandler(); }); }, nullptr);
	k_timer_start(&sMeasurementsTimer, K_MSEC(kMeasurementsIntervalMs), K_MSEC(kMeasurementsIntervalMs));

#ifdef CONFIG_MCUMGR_TRANSPORT_BT
	Nrf::GetDFUOverSMP().StartServer();
#endif

	return Nrf::Matter::StartServer();
}

CHIP_ERROR AppTask::StartApp()
{
    //Nrf::Matter::BindingHandler::Init();
	ReturnErrorOnFailure(Init());

	while (true) {
		Nrf::DispatchNextTask();
	}

	return CHIP_NO_ERROR;
}
```

## src/app_task.h
```c
/*
 * Copyright (c) 2021 Nordic Semiconductor ASA
 *
 * SPDX-License-Identifier: LicenseRef-Nordic-5-Clause
 */

#pragma once


#include "binding/binding_handler.h"
#include "board/led_widget.h"
#include "board/board.h"

#include <atomic>
#include <app/util/basic-types.h>
#include <lib/core/CHIPError.h>
#include <app/clusters/identify-server/identify-server.h>
#include <platform/CHIPDeviceLayer.h>

class AppTask {
public:
	static AppTask &Instance()
	{
		static AppTask sAppTask;
		return sAppTask;
	};

	CHIP_ERROR StartApp();

	static void OnIdentifyStart(Identify *);
	static void OnIdentifyStop(Identify *);

	static void UpdateLedState();

    enum class Action : uint8_t {
	    PressButton, /* The button of the device is pressed. */
	    Rotate, /* The device is rotated. */
	    Tap, /* The device is tapped while placed on a flat surface. */
	    Idle, /* The device is placed on a flat surface. */
	    UpDown /* The device is moved in updown direction. */
	};

	void InitiateActionSwitch(Action action);
	static void SwitchChangedHandler(const EmberBindingTableEntry &binding,
					 chip::OperationalDeviceProxy *deviceProxy,
					 Nrf::Matter::BindingHandler::BindingData &bindingData);

    static void ButtonEventHandler(Nrf::ButtonState state, Nrf::ButtonMask hasChanged);
    static void WindowCoveringActionEventHandler();
private:
	CHIP_ERROR Init();

	void UpdatePowerSourceClusterState();

	static void MeasurementsTimerHandler();
	static void IdentifyTimerHandler();

	Nrf::LEDWidget *mRedLED;
	Nrf::LEDWidget *mGreenLED;
	Nrf::LEDWidget *mBlueLED;
};
```
